## conf/layer.conf
```bitbake
# We have a conf and classes directory, append to BBPATH
BBPATH .= ":${LAYERDIR}"

# We have a recipes directory, add to BBFILES
BBFILES += "${LAYERDIR}/recipes-*/*/*.bb ${LAYERDIR}/recipes-*/*/*.bbappend"

BBFILE_COLLECTIONS += "ros2-layer"
BBFILE_PATTERN_ros2-layer := "^${LAYERDIR}/"
BBFILE_PRIORITY_ros2-layer = "7"
```

## docker_ros2/build/conf/bblayers.conf
```bitbake
# POKY_BBLAYERS_CONF_VERSION is increased each time build/conf/bblayers.conf
# changes incompatibly
POKY_BBLAYERS_CONF_VERSION = "2"

BBPATH = "${TOPDIR}"
BBFILES ?= ""

BBLAYERS ?= " \
  /home/build/poky/meta \
  /home/build/poky/meta-poky \
  /home/build/poky/meta-yocto-bsp \
  /home/build/meta-xilinx \
  /home/build/meta-openembedded/meta-oe \
  /home/build/meta-openembedded/meta-python \
  /home/build/meta-zynqberry \
  /home/build/meta-zynqberry-pxfmini \
  /home/build/meta-ros2 \
  "
```
